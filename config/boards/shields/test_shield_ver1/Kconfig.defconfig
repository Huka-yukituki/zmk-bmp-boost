## config/boards/shields/test_shield_ver1/Kconfig.defconfig
```kconfig
if SHIELD_TEST_SHIELD_VER1

config ZMK_KEYBOARD_NAME
    default "Tester ver1"

config ZMK_BLE
    def_bool n

config SETTINGS
    def_bool n

endif
```

## config/boards/shields/test_shield_ver1/Kconfig.shield
```kconfig
config SHIELD_TEST_SHIELD_VER1
    def_bool $(shields_list_contains,test_shield_ver1)
```
